## meta-agl-bsp/conf/layer.conf
```bitbake
# We have a conf and classes directory, add to BBPATH
BBPATH =. "${LAYERDIR}:"

# Let us add layer-specific bbappends which are only applied when that
# layer is included in our configuration -
# e.g. only add layers if a bsp is present.
BBFILES += "${@' '.join('${LAYERDIR}/%s/recipes*/*/*.bbappend' % layer \
               for layer in BBFILE_COLLECTIONS.split())}"

BBFILE_COLLECTIONS += "aglbsp"
BBFILE_PATTERN_aglbsp = "^${LAYERDIR}/"
BBFILE_PRIORITY_aglbsp = "7"
```

## meta-agl-bsp/conf/machine/qemuarm.conf
```bitbake
#@TYPE: Machine
#@NAME: armv7a
#@DESCRIPTION: generic ARM 32bit

require conf/machine/include/qemu.inc
require conf/machine/include/arm/arch-armv7ve.inc

KERNEL_IMAGETYPE = "zImage"

SERIAL_CONSOLES ?= "38400;ttyAMA0 38400;hvc0"

# For runqemu
QB_SYSTEM_NAME = "qemu-system-arm"
QB_MACHINE = "-machine virt"

# Add the 'virtio-rng-pci' device otherwise the guest may run out of entropy
QB_OPT_APPEND = "-show-cursor -usb -device virtio-rng-pci"
PREFERRED_VERSION_linux-yocto ??= "4.18%"
```

## meta-agl-bsp/conf/machine/raspberrypi4.conf
```bitbake
#@TYPE: Machine
#@NAME: RaspberryPi 4 Development Board (32bit)
#@DESCRIPTION: Machine configuration for the RaspberryPi 4 in 32 bit mode

DEFAULTTUNE ?= "cortexa7thf-neon-vfpv4"
require conf/machine/include/tune-cortexa7.inc
include conf/machine/include/rpi-base.inc

MACHINE_EXTRA_RRECOMMENDS += "\
    linux-firmware-rpidistro-bcm43455 \
    bluez-firmware-rpidistro-bcm4345c0-hcd \
    pi-bluetooth \
"

# 'l' stands for LPAE
SDIMG_KERNELIMAGE ?= "kernel7l.img"
UBOOT_MACHINE = "rpi_4_32b_config"
SERIAL_CONSOLES ?= "115200;ttyS0"

MACHINE_FEATURES_append = " vc4graphics"
VC4DTBO ?= "vc4-fkms-v3d"

RPI_KERNEL_DEVICETREE_OVERLAYS_remove_raspberrypi4 = "overlays/lirc-rpi.dtbo"
RPI_KERNEL_DEVICETREE_OVERLAYS_append_raspberrypi4 = " overlays/mcp2515-can0.dtbo overlays/vc4-fkms-v3d.dtbo"
RPI_KERNEL_DEVICETREE_remove_raspberrypi4 = "bcm2708-rpi-0-w.dtb"
RPI_KERNEL_DEVICETREE_append_raspberrypi4 = " bcm2708-rpi-zero-w.dtb bcm2711-rpi-4-b.dtb"
```

## meta-agl-bsp/meta-rcar-gen3-adas/conf/layer.conf
```bitbake
# We have a conf and classes directory, append to BBPATH
BBPATH .= ":${LAYERDIR}"

# We have a recipes directory, add to BBFILES
BBFILES += " \
    ${LAYERDIR}/../../../bsp/meta-rcar/meta-rcar-gen3-adas/recipes-*/*/*.bb \
    ${LAYERDIR}/../../../bsp/meta-rcar/meta-rcar-gen3-adas/recipes-*/*/*.bbappend \
    ${LAYERDIR}/recipes-*/*/*.bb \
    ${LAYERDIR}/recipes-*/*/*.bbappend \
"

BBFILE_COLLECTIONS += "rcar-gen3-cogent"
BBFILE_PATTERN_rcar-gen3-cogent := "^${LAYERDIR}/../../../bsp/meta-rcar/meta-rcar-gen3-adas/"
BBFILE_PRIORITY_rcar-gen3-cogent = "7"

LAYERSERIES_COMPAT_rcar-gen3-cogent = "thud"

# Custom packages
IMAGE_INSTALL_append_rcar-gen3 = " \
    can-utils \
    libsocketcan \
    spidev-dbg spidev-test \
    e2fsprogs \
    e2fsprogs-tune2fs \
    ethtool \
    pciutils \
    usbutils \
    mtd-utils \
    capture \
    v4l2-fw \
    iperf3 \
    bonnie++ \
    lmbench \
    eglibc-utils \
    mm-init \
    iio-utils \
    most-tools \
"

# Radio packages
IMAGE_INSTALL_append_rcar-gen3 += " \
    si-tools \
    si-init \
    linux-firmware-wl18xx \
    ti-bt \
    ti-bt-firmware \
    bluez5 \
    bluez5-testtools \
    ofono \
    ofono-tests \
"

# IMP
IMAGE_INSTALL_append_r8a7797 += " \
    kernel-module-uio-imp \
    kernel-module-cmemdrv \
    udev-rules-cvlib \
"

IMAGE_INSTALL_append_r8a7798 += " \
    kernel-module-uio-imp \
    kernel-module-cmemdrv \
    udev-rules-cvlib \
"

DISTRO_FEATURES_append = " surroundview "
DISTRO_FEATURES_append = " bluetooth"


BBMASK += "/meta-rcar-gen3-adas/recipes-core/systemd/"
BBMASK += "/meta-rcar-gen3-adas/recipes-graphics/opencv/"
BBMASK += "/meta-rcar-gen3-adas/recipes-devtools/valgrind/"
```

## meta-agl-distro/conf/distro/fixed-srcrevs-eel-4.99.1.inc
```bitbake
SRCREV_pn-af-binder_forcevariable = "159c895986f2358d6df8bb5804cc4419cc6b457f"
SRCREV_pn-af-main_forcevariable = "2bbe66dda7fadf2d08a57e2b0e0fa8841a118c81"
SRCREV_pn-agl-audio-plugin_forcevariable = "952d404e87ca6001e546fe9105bdb6760c468760"
SRCREV_pn-agl-service-bluetooth_forcevariable = "a51cfc5b18807e8fbff9305b4bc7aeb32d2d25cd"
SRCREV_pn-agl-service-mediascanner_forcevariable = "8f53e0af37a77ef456debf9a3cd63a5948c12b9d"
SRCREV_pn-agl-service-radio_forcevariable = "18f5940ce349f2eb9bf6532b7e07311c52691a2d"
SRCREV_pn-agl-service-wifi_forcevariable = "af8fd545eee24fb2d6a8d472912f9c606b044278"
SRCREV_pn-aktualizr_forcevariable = "ed2c9684d3b7e605b41a3e7dda0afded1d4a084c"
SRCREV_pn-audiomanager_forcevariable = "daf851ee7a41d1b0572c0c95e15f61e427ce97f1"
SRCREV_pn-audiomanager-plugins_forcevariable = "bf5c5e8198b85e84363770150d5a02f553f43296"
SRCREV_pn-bluez-tools_forcevariable = "97efd293491ad7ec96a655665339908f2478b3d1"
SRCREV_pn-connman-ncurses_forcevariable = "ad4261a2f87c914667b1f6841c913f6b08d373e2"
SRCREV_pn-cynara_forcevariable = "973765e329f8a84c1549cb2b0c65ccb1cce3c2d3"
SRCREV_pn-dashboard_forcevariable = "c320e8202d3347b1513be57786d4d70b55551351"
SRCREV_pn-dlt-daemon_forcevariable = "e9a486a08fff6d3cc7133a350cec3ee10f463207"
SRCREV_pn-dnf_forcevariable = "f0093d672d3069cfee8447973ae70ef615fd8886"
SRCREV_pn-high-level-viwi-service_forcevariable = "c4935e58769966a9b79b21c45798ab8828fe0ad0"
SRCREV_pn-homescreenappframeworkbinderagl_forcevariable = "d7218d957c77c457a458a535b67afc4281e611ab"
SRCREV_pn-homescreen_forcevariable = "69be38c5d975c96eee7adab238ffd608b99d8514"
SRCREV_pn-hvac_forcevariable = "ddff06a62bdb66c50645a9c56d5959bc09193d9d"
SRCREV_pn-inputeventmanager_forcevariable = "b2f1646ac78cf61acd66c643b7638bd1b007d5a0"
SRCREV_pn-libatasmart_forcevariable = "de6258940960443038b4c1651dfda3620075e870"
SRCREV_pn-libdnf_forcevariable = "367545629cc01a8e622890d89bd13d062ce60d7b"
SRCREV_pn-libsolv_forcevariable = "ba32f8286d3deec6faaabc79762a4760e9af0a07"
SRCREV_pn-low-can-demo_forcevariable = "4b325a18b9d2d7906369eeb66044fadc9e1c692a"
SRCREV_pn-low-level-can-service_forcevariable = "cfefec3991f272f5eaaa3f909f0f4f402ea5b04f"
SRCREV_pn-mediaplayer_forcevariable = "001f10ceffba5c1c8a5da89c5daa16fe69e36197"
SRCREV_pn-mixer_forcevariable = "9147d58239a4e443560dc4f14a1de21dcfc75827"
SRCREV_pn-module-router_forcevariable = "8104a3174e6f54ace53066ab1797d9b9bd2bdf63"
SRCREV_pn-navigation_forcevariable = "acbb9ea0678bd2f21f268000332a4786e87fb3f6"
SRCREV_pn-ostree_forcevariable = "3b09620c2738bce4ed45e099cf2e4c5df7671d39"
SRCREV_pn-phone_forcevariable = "05861567c962cea3216a2c46227366639fa70525"
SRCREV_pn-poiapp_forcevariable = "b0e059007de776450c91c983a2bcac20414617e9"
SRCREV_pn-qt3d_forcevariable = "440589a0747d9668fec3ff924b390d75be5c6733"
SRCREV_pn-qtbase_forcevariable = "49dc9aa409d727824f26b246054a22b5a7dd5980"
SRCREV_pn-qtcharts_forcevariable = "057b3e2d6a96b42b890a0d007a8801d260c3de48"
SRCREV_pn-qtconnectivity_forcevariable = "1afb57ed92a25bbc000ea4c4d7662cb8b9e267ee"
SRCREV_pn-qtdeclarative_forcevariable = "fffb997e192a72b4dcd66edc2fbad5473dd359f3"
SRCREV_pn-qtenginio_forcevariable = "0555cf73c8b5abd41d8a4ff02457315c9e7c667d"
SRCREV_pn-qtgraphicaleffects_forcevariable = "1583bb5569cfc50141d879107a46146d5ccccf28"
SRCREV_pn-qtimageformats_forcevariable = "cd2de115c6216ad747cf4803e65a4ce4af220795"
SRCREV_pn-qtlocation_forcevariable = "41cc347040226d2c5c16b9df001d03f2724b87e5"
SRCREV_pn-qtmultimedia_forcevariable = "544a8a4251ff9694780e563ddb6e4af1325e0115"
SRCREV_pn-qtquick1_forcevariable = "64faeb0d8003e699a4d09e7dcee1ef6eb10302ad"
SRCREV_pn-qtquickcontrols2-agl_forcevariable = "9156d579fef7baac836f1fee51c83061941176b8"
SRCREV_pn-qtquickcontrols2-agl-style_forcevariable = "a78db8638590c797c78c36b2ef3de5ed9c012bba"
SRCREV_pn-qtquickcontrols2_forcevariable = "6f7852a307c7ebbdb3b6efa00cbf7626b072bbc1"
SRCREV_pn-qtquickcontrols_forcevariable = "201c86391c7ff78d570fdec6e0c0b71eb1e9aae4"
SRCREV_pn-qtscript_forcevariable = "c35df2ec0ee05351912e768d298a7c627dbdd1ef"
SRCREV_pn-qtsensors_forcevariable = "1220a31e6c2f91b34b4a05773621dddab8c4315a"
SRCREV_pn-qtserialbus_forcevariable = "c8fe92ef54b2d310e8c8c143962fd6f43bf46c27"
SRCREV_pn-qtserialport_forcevariable = "74aad2578ecb6739007449a06a54dd7abd64c85b"
SRCREV_pn-qtsvg_forcevariable = "1b3a7ae14d25f1caa3f6bedad3cfeb7d83b3904e"
SRCREV_pn-qtsystems_forcevariable = "434af789f0d56ca7a521ca2d9ec8cf3b1057fd37"
SRCREV_pn-qttools_forcevariable = "30c10900adecca55faa1d59c2f0caac74b1f9df6"
SRCREV_pn-qttranslations_forcevariable = "c0ae29b2328922f16cb2305f8579c2a869c871b0"
SRCREV_pn-qtvirtualkeyboard_forcevariable = "cfa4ab4cbf13971d4b71ee920353822755a3bf31"
SRCREV_pn-qtwayland_forcevariable = "0e2a950895805457a45abe860bc91a7cc4ba405e"
SRCREV_pn-qtwebchannel_forcevariable = "e3ddde4b26a72d57beeeed4e2d3384896e3a399d"
SRCREV_pn-qtwebkit-examples_forcevariable = "f0898f83abdcacc8bd3bca3479884376b0963398"
SRCREV_pn-qtwebkit_forcevariable = "74ac5b0f3489f9a08d083b6c9607c9d5c2d4afd2"
SRCREV_pn-qtwebsockets_forcevariable = "afb3c58d035db1119666c8556c215187be4f64b8"
SRCREV_pn-qtxmlpatterns_forcevariable = "9f7e01b582b1bd83cc6b8a854c510871335e2e74"
SRCREV_pn-radio_forcevariable = "c46a56ac144e7399f2172e56a7a22d46d580c830"
SRCREV_pn-rpm_forcevariable = "a8e51b3bb05c6acb1d9b2e3d34f859ddda1677be"
SRCREV_pn-sdl-core_forcevariable = "5043a62c8ec6bc7248c1ba5fee3f58eefc708bc4"
SRCREV_pn-security-manager_forcevariable = "860305a595d681d650024ad07b3b0977e1fcb0a6"
SRCREV_pn-settings_forcevariable = "6b63e1715302215c9c6b923df41fbe4a6635a6b7"
SRCREV_pn-systemd_forcevariable = "a1e2ef7ec912902d8142e7cb5830cbfb47dba86c"
SRCREV_pn-wayland-ivi-extension_forcevariable = "3ebb7b74e60a35d549284e7f77183de66bef18e0"
SRCREV_pn-windowmanager_forcevariable = "eeedc5e9e67917bd3346dbe5332e667757a3b28d"
```

## meta-agl-distro/conf/distro/include/aarch64-tune.inc
```bitbake
# We should not need any includes as the board should include the right set already. This is just for reference.
# include conf/machine/include/arm/arch-armv8.inc
DEFAULTTUNE = "aarch64"
# not yet ready
#QB_SYSTEM_NAME ?= "qemu-system-aarch"
#QB_DEFAULT_KERNEL ?= "zImage"
#QB_DEFAULT_FSTYPE ?= "ext4"
#QB_MACHINE ?= "-machine foo"
#QB_CPU ?= "-cpu bar"
```

## meta-agl-distro/conf/distro/include/arm-default-tune.inc
```bitbake
def arm_tune_handler(d):
    features = d.getVar('TUNE_FEATURES', True).split()
    if 'armv7a' in features or 'armv7ve' in features:
        tune = 'armv7athf'
        if 'bigendian' in features:
            tune += 'b'
        if 'vfpv3' in features:
            tune += '-vfpv3'
        if 'vfpv3d16' in features:
            tune += '-vfpv3d16'
        if 'neon' in features:
            tune += '-neon'
        if 'vfpv4' in features:
            tune += '-vfpv4'
    else:
        tune = d.getVar('DEFAULTTUNE', True)
    return tune
DEFAULTTUNE_agl := "${@arm_tune_handler(d)}"
```

## meta-agl-distro/conf/distro/include/arm-tune.inc
```bitbake
# DEFAULTTUNE overrides for AGL on ARM 32bit

# We should not need the tuning include below as the BSP should include the right set already.
# A double inclusion would produce a warning. This include line is just for reference
#   include conf/machine/include/arm/arch-armv7ve.inc
# medium profile boards need to
#   include conf/machine/include/arch/arm-armv7-a.inc

DEFAULTTUNE = "${@bb.utils.contains('DISTRO_FEATURES', 'agl-medium-arm-compiler', 'armv7athf-neon', 'armv7vethf-neon-vfpv4', d)}"
QB_SYSTEM_NAME ?= "qemu-system-arm"
QB_DEFAULT_KERNEL ?= "zImage"
QB_DEFAULT_FSTYPE ?= "ext4"
QB_MACHINE ?= "${@bb.utils.contains('DISTRO_FEATURES', 'agl-medium-arm-compiler', '-machine vexpress-a9', '-machine vexpress-a15', d)}"
QB_CPU ?= "${@bb.utils.contains('DISTRO_FEATURES', 'agl-medium-arm-compiler', '-cpu cortex-a9', '-cpu cortex-a15', d)}"
```

## meta-agl-distro/conf/distro/include/x86_64-tune.inc
```bitbake
# DEFAULTTUNE overrides for AGL on x86-64

# We should not need the tuning include below as the BSP should include the right set already.
# A double inclusion would produce a warning. This include line is just for reference
#include conf/machine/include/tune-corei7.inc
DEFAULTTUNE = "corei7-64"

# shortened copy of tune-corei7.inc due to bug in inclusion for tune-core2.inc
# TUNE_ARCH is using .= x86-64 , if done twice, you get x86-64x86-64 as TUNE_ARCH :/
# we should have at least the core2 tunings by default (=qemux86-64)

# Extra tune features
TUNEVALID[corei7] = "Enable corei7 specific processor optimizations"
TUNE_CCARGS = "${@bb.utils.contains('TUNE_FEATURES', 'corei7', ' -march=corei7 -mtune=corei7 -mfpmath=sse -msse4.2', '', d)}"

# Extra tune selections
AVAILTUNES += "corei7-32"
TUNE_FEATURES_tune-corei7-32 = "${TUNE_FEATURES_tune-x86} corei7"
BASE_LIB_tune-corei7-32 = "lib"
TUNE_PKGARCH_tune-corei7-32 = "corei7-32"
PACKAGE_EXTRA_ARCHS_tune-corei7-32 = "${PACKAGE_EXTRA_ARCHS_tune-core2-32} corei7-32"
QEMU_EXTRAOPTIONS_corei7-32 = " -cpu Nehalem,check=false"
QB_CPU_corei7-32 = "-cpu Nehalem,check=false"
QB_MACHINE_corei7-32 = "-machine q35"

AVAILTUNES += "corei7-64"
TUNE_FEATURES_tune-corei7-64 = "${TUNE_FEATURES_tune-x86-64} corei7"
BASE_LIB_tune-corei7-64 = "lib64"
TUNE_PKGARCH_tune-corei7-64 = "corei7-64"
PACKAGE_EXTRA_ARCHS_tune-corei7-64 = "${PACKAGE_EXTRA_ARCHS_tune-core2-64} corei7-64"
QEMU_EXTRAOPTIONS_corei7-64 = " -cpu Nehalem,check=false"
QB_CPU_corei7-64 = " -cpu Nehalem,check=false"
QB_MACHINE_corei7-64 = "-machine q35"

AVAILTUNES += "corei7-64-x32"
TUNE_FEATURES_tune-corei7-64-x32 = "${TUNE_FEATURES_tune-x86-64-x32} corei7"
BASE_LIB_tune-corei7-64-x32 = "libx32"
TUNE_PKGARCH_tune-corei7-64-x32 = "corei7-64-x32"
PACKAGE_EXTRA_ARCHS_tune-corei7-64-x32 = "${PACKAGE_EXTRA_ARCHS_tune-core2-64-x32} corei7-64-x32"
QEMU_EXTRAOPTIONS_corei7-64-x32 = " -cpu Nehalem,check=false"
QB_CPU_corei7-64-x32 = "-cpu Nehalem,check=false"
QB_MACHINE_corei7-64-x32 = "-machine q35"

TUNE_ARCH = "${@bb.utils.contains('TUNE_FEATURES', 'm64', '${X86ARCH64}', '' ,d)}"

# Bump qemux86-64 up to corei7
AVAILTUNES += "qemux86-64"
TUNE_FEATURES_tune-qemux86-64 = "${TUNE_FEATURES_tune-x86-64} corei7"
BASE_LIB_tune-qemux86-64 = "lib64"
TUNE_PKGARCH_tune-qemux86-64 = "corei7-64"
PACKAGE_EXTRA_ARCHS_tune-qemux86-64 = "${PACKAGE_EXTRA_ARCHS_tune-core2-64} corei7-64"
QEMU_EXTRAOPTIONS_qemux86-64 = " -cpu Nehalem,check=false"
QB_CPU_qemux86-64 = " -cpu Nehalem,check=false"
QB_CPU_KVM_x86 = "-cpu Nehalem,check=false"
QB_CPU_KVM_x86-64 = "-cpu Nehalem,check=false"
QB_MACHINE_qemux86-64 = "-machine q35"
```
